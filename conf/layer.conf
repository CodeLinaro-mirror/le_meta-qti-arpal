## conf/layer.conf
```bitbake
BBFILES += "${LAYERDIR}/recipes/*/*.bb ${LAYERDIR}/recipes/*/*.bbappend"
BBPATH .= ":${LAYERDIR}"
BBFILE_COLLECTIONS += "qti-arpal"
BBFILE_PRIORITY_qti-arpal = "12"
BBFILE_PATTERN_qti-arpal := "^${LAYERDIR}/"
LAYERSERIES_COMPAT_qti-arpal = "kirkstone scarthgap wrynose"
LAYERDEPENDS_qti-arpal := "\
   qti-agm \
   qti-audio \
   qti-args \
   qti-bsp \
   core"
LAYERVERSION_qti-arpal = "1"
```
